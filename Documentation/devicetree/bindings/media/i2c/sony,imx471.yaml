## Documentation/devicetree/bindings/media/i2c/sony,imx471.yaml
```yaml
# SPDX-License-Identifier: (GPL-2.0-only OR BSD-2-Clause)
%YAML 1.2
---
$id: http://devicetree.org/schemas/media/i2c/sony,imx471.yaml#
$schema: http://devicetree.org/meta-schemas/core.yaml#

title: Sony IMX471 Sensor

maintainers:
  - Nikhil Kaushik <nikhil.kaushik@outlook.com>

description:
  The Sony IMX471 is a 16 MP (4656x3496 active pixels) CMOS image
  sensor with a 4-lane MIPI CSI-2 D-PHY output, controlled over I2C (CCI).
  It is found as the front camera in smartphones and as the user-facing
  camera in some laptops.

allOf:
  - $ref: /schemas/media/video-interface-devices.yaml#

properties:
  compatible:
    const: sony,imx471

  reg:
    maxItems: 1

  clocks:
    description: Input clock (INCK), 19.2 MHz.
    maxItems: 1

  avdd-supply:
    description: Analog power supply (2.8 V).

  dvdd-supply:
    description: Digital core power supply (1.05 V).

  dovdd-supply:
    description: Interface power supply (1.8 V).

  reset-gpios:
    description: Reset (XCLR) GPIO, active low.
    maxItems: 1

  port:
    $ref: /schemas/graph.yaml#/$defs/port-base
    additionalProperties: false

    properties:
      endpoint:
        $ref: /schemas/media/video-interfaces.yaml#
        unevaluatedProperties: false

        properties:
          data-lanes:
            minItems: 4
            maxItems: 4

          link-frequencies: true

        required:
          - data-lanes
          - link-frequencies

    required:
      - endpoint

required:
  - compatible
  - reg
  - clocks
  - avdd-supply
  - dvdd-supply
  - dovdd-supply
  - port

unevaluatedProperties: false

examples:
  - |
    #include <dt-bindings/gpio/gpio.h>

    i2c {
        #address-cells = <1>;
        #size-cells = <0>;

        camera@10 {
            compatible = "sony,imx471";
            reg = <0x10>;

            clocks = <&cam_mclk0>;
            assigned-clocks = <&cam_mclk0>;
            assigned-clock-rates = <19200000>;

            reset-gpios = <&tlmm 23 GPIO_ACTIVE_LOW>;

            avdd-supply = <&cam_vana_ldo>;
            dvdd-supply = <&cam_dvdd_ldo>;
            dovdd-supply = <&cam_vio_ldo>;

            orientation = <0>;
            rotation = <90>;

            port {
                endpoint {
                    data-lanes = <1 2 3 4>;
                    link-frequencies = /bits/ 64 <164800000>;
                    remote-endpoint = <&csiphy1_ep>;
                };
            };
        };
    };
...
```
